/dts-v1/;
/plugin/;

// WS281x PWM for the Pi 5 RP1 PWM0 block: GPIO18 is PWM channel 2 (alt function a3).
// Based on rp1_ws281x_pwm/rp1_ws281x_pwm.dts from jgarff/rpi_ws281x @ 1396df4 (pi5 branch).
// The only local changes are fragment@1 (the GPIO18 pin group, function pwm0) and the
// pinctrl-0/pinctrl-names properties on the driver node, which apply the pin group when
// rp1_ws281x_pwm binds at module load.

/ {
    fragment@0 {
        target-path = "/axi/pcie@1000120000/rp1";

        __overlay__ {
            #address-cells = <2>;
            #size-cells = <2>;

            ws281x_pwm@98000 {
                compatible = "rp1-ws281x-pwm";
                clocks = <&rp1_clocks 0x11>;
                assigned-clocks = <&rp1_clocks 0x11>;
                assigned-clock-rates = <2400000>;
                reg = <0xc0 0x40098000 0x00 0x100>;
                #pwm-cells = <0x03>;
                dmas = <&rp1_dma 0x18>;  // RP1_DMA_PWM0
                dma-names = "pwm0";
                status = "okay";
                // applied when the rp1_ws281x_pwm driver binds (module load)
                pinctrl-names = "default";
                pinctrl-0 = <&ws281x_gpio18>;
            };
        };
    };

    fragment@1 {
        target-path = "/axi/pcie@1000120000/rp1/gpio@d0000";

        __overlay__ {
            ws281x_gpio18: ws281x_gpio18 {
                function = "pwm0";
                pins = "gpio18";
                bias-disable;
            };
        };
    };
};
